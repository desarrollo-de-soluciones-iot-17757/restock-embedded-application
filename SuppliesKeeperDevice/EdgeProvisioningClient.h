#ifndef EDGE_PROVISIONING_CLIENT_H
#define EDGE_PROVISIONING_CLIENT_H

/**
 * @file EdgeProvisioningClient.h
 * @brief HTTP provisioning client for Restock Edge-Device bootstrap.
 *
 * @details
 * This component performs the initial HTTP handshake between the embedded
 * device and the Edge Gateway. The device sends its DEVICE_ID and MAC address,
 * while the factory API key is sent as an HTTP header. If the Edge authorizes
 * the device, it returns MQTT credentials and initial display/product
 * configuration.
 *
 * This class is intentionally outside the ModestIoT framework because the
 * current framework version does not include Edge provisioning behavior.
 *
 * @author Gabriela Shapiama
 * @date Jun 15, 2026
 * @version 0.2
 */

#include <Arduino.h>
#include <HTTPClient.h>
#include <WiFi.h>
#include <ModestIoT.h>

/**
 * @brief Provisioning data returned by the Edge Gateway.
 */
struct ProvisioningResult {
    bool authorized = false;              ///< Indicates whether the Edge authorized the device.
    String mqttClientId = "";             ///< MQTT client identifier.
    String mqttUsername = "";             ///< MQTT username generated by the Edge.
    String mqttPassword = "";             ///< MQTT password/token generated by the Edge.
    String mqttBrokerHost = "";           ///< MQTT broker host.
    uint16_t mqttBrokerPort = 0;          ///< MQTT broker port.
    String telemetryTopic = "";           ///< Backward-compatible generic MQTT telemetry topic.
    String environmentTelemetryTopic = ""; ///< MQTT topic for environmental telemetry.
    String weightTelemetryTopic = "";      ///< MQTT topic for weight telemetry.
    String healthTelemetryTopic = "";      ///< MQTT topic for health telemetry.
    String responseTopic = "";             ///< Canonical Edge-to-embedded response subscription.
    String legacyResponseTopic = "";       ///< Temporary legacy response subscription.
    String displayMode = "";              ///< Initial display mode configured from Cloud/Edge.
    String productUnitLabel = "";         ///< Product/inventory unit label returned by Edge, e.g. kg, bottles, boxes.
    float convertedQuantity = 0.0f;       ///< Product quantity already converted by Edge for display.
};

/**
 * @brief Client responsible for requesting device provisioning from Edge.
 */
class EdgeProvisioningClient {
private:
    ConnectivityDriver& connectivityDriver; ///< Network transport driver.
    const char* provisioningEndpointUrl;     ///< Edge provisioning endpoint.
    unsigned long timeoutInMilliseconds;     ///< HTTP timeout.

    /**
     * @brief Reads a string value from an ArduinoJson variant.
     *
     * @param value JSON value.
     * @param fallback Fallback string when value is not present.
     * @return String value.
     */
    static String readString(JsonVariantConst value, const String& fallback) {
        if (value.isNull()) {
            return fallback;
        }

        if (value.is<const char*>()) {
            return String(value.as<const char*>());
        }

        return fallback;
    }

    /**
     * @brief Reads an unsigned integer value from an ArduinoJson variant.
     *
     * @param value JSON value.
     * @param fallback Fallback value.
     * @return Parsed unsigned integer value.
     */
    static uint16_t readUnsignedInteger(JsonVariantConst value, uint16_t fallback) {
        if (value.isNull()) {
            return fallback;
        }

        if (value.is<unsigned int>()) {
            return static_cast<uint16_t>(value.as<unsigned int>());
        }

        if (value.is<int>()) {
            int signedValue = value.as<int>();
            return signedValue > 0 ? static_cast<uint16_t>(signedValue) : fallback;
        }

        return fallback;
    }

    /**
     * @brief Reads a float value from an ArduinoJson variant.
     *
     * @param value JSON value.
     * @param fallback Fallback value.
     * @return Parsed float value.
     */
    static float readFloat(JsonVariantConst value, float fallback) {
        if (value.isNull()) {
            return fallback;
        }

        if (value.is<float>() || value.is<double>() || value.is<int>() || value.is<unsigned int>()) {
            return value.as<float>();
        }

        if (value.is<const char*>()) {
            return String(value.as<const char*>()).toFloat();
        }

        return fallback;
    }

public:
    /**
     * @brief Creates the provisioning client.
     *
     * @param connectivityDriver Network connectivity driver.
     * @param provisioningEndpointUrl Edge provisioning endpoint URL.
     * @param timeoutInMilliseconds HTTP timeout in milliseconds.
     */
    EdgeProvisioningClient(
        ConnectivityDriver& connectivityDriver,
        const char* provisioningEndpointUrl,
        unsigned long timeoutInMilliseconds = 10000UL
    )
        : connectivityDriver(connectivityDriver),
          provisioningEndpointUrl(provisioningEndpointUrl),
          timeoutInMilliseconds(timeoutInMilliseconds) {}

    /**
     * @brief Requests MQTT credentials and display/product configuration from Edge.
     *
     * @param deviceId Device identifier registered in Cloud/Edge.
     * @param apiKey Factory API key used for initial validation.
     * @return Provisioning result.
     */
    ProvisioningResult requestDeviceProvisioning(
        const char* deviceId,
        const char* apiKey
    ) {
        ProvisioningResult result;

        if (!connectivityDriver.canTransmit()) {
            Serial.println("[Provisioning] Network not ready. Provisioning skipped.");
            connectivityDriver.connect();
            return result;
        }

        JsonDocument requestDocument;
        requestDocument["device_id"] = deviceId;
        requestDocument["mac_address"] = WiFi.macAddress();

        String requestPayload;
        serializeJson(requestDocument, requestPayload);

        Serial.println("[Provisioning] Sending device provisioning request:");
        Serial.println(requestPayload);

        HTTPClient httpClient;
        httpClient.begin(provisioningEndpointUrl);
        httpClient.setTimeout(timeoutInMilliseconds);
        httpClient.addHeader("Content-Type", "application/json");
        httpClient.addHeader("X-API-Key", apiKey);

        int httpStatusCode = httpClient.POST(requestPayload);
        String responsePayload = httpClient.getString();

        Serial.printf("[Provisioning] Edge response status: %d\n", httpStatusCode);
        if (httpStatusCode >= 200 && httpStatusCode < 300) {
            Serial.println(responsePayload);
        } else {
            Serial.println("[Provisioning] Non-success response body omitted.");
        }

        httpClient.end();

        if (httpStatusCode < 200 || httpStatusCode >= 300) {
            Serial.println("[Provisioning] Edge rejected or failed the provisioning request.");
            return result;
        }

        JsonDocument responseDocument;
        DeserializationError error = deserializeJson(responseDocument, responsePayload);

        if (error) {
            Serial.printf("[Provisioning] Invalid JSON response: %s\n", error.c_str());
            return result;
        }

        JsonVariantConst mqttNode = responseDocument["mqtt"];
        JsonVariantConst displayNode = responseDocument["display"];
        JsonVariantConst productNode = responseDocument["product"];

        result.authorized = responseDocument["authorized"] | true;

        result.mqttClientId = readString(
            responseDocument["mqtt_client_id"],
            readString(mqttNode["client_id"], deviceId)
        );

        result.mqttUsername = readString(
            responseDocument["mqtt_user"],
            readString(mqttNode["username"], "")
        );

        result.mqttPassword = readString(
            responseDocument["mqtt_pass"],
            readString(mqttNode["password"], "")
        );

        result.mqttBrokerHost = readString(
            responseDocument["mqtt_broker_host"],
            readString(mqttNode["host"], "")
        );

        result.mqttBrokerPort = readUnsignedInteger(
            responseDocument["mqtt_broker_port"],
            readUnsignedInteger(mqttNode["port"], 0)
        );

        result.telemetryTopic = readString(
            responseDocument["telemetry_topic"],
            readString(mqttNode["telemetry_topic"], "")
        );

        result.environmentTelemetryTopic = readString(
            responseDocument["environment_topic"],
            readString(mqttNode["environment_topic"], "")
        );

        result.weightTelemetryTopic = readString(
            responseDocument["weight_topic"],
            readString(mqttNode["weight_topic"], "")
        );

        result.healthTelemetryTopic = readString(
            responseDocument["health_topic"],
            readString(mqttNode["health_topic"], "")
        );

        result.responseTopic = readString(
            responseDocument["response_topic"],
            readString(mqttNode["response_topic"], "")
        );

        result.legacyResponseTopic = readString(
            responseDocument["legacy_response_topic"],
            readString(mqttNode["legacy_response_topic"], "")
        );

        result.displayMode = readString(
            responseDocument["display_mode"],
            readString(displayNode["mode"], "")
        );

        result.productUnitLabel = readString(
            responseDocument["product_unit_label"],
            readString(
                displayNode["product_unit_label"],
                readString(
                    displayNode["unit_label"],
                    readString(productNode["unit_label"], "")
                )
            )
        );

        result.convertedQuantity = readFloat(
            responseDocument["converted_quantity"],
            readFloat(
                displayNode["converted_quantity"],
                readFloat(productNode["converted_quantity"], 0.0f)
            )
        );

        Serial.println("[Provisioning] Provisioning response parsed successfully.");

        return result;
    }
};

#endif // EDGE_PROVISIONING_CLIENT_H
